#include "web.h"
#include "app.h"
#include "config.h"
#include "meter.h"
#include "mqtt.h"
#include "settings.h"
#include "util.h"
#include <ArduinoJson.h>
#include <Update.h>
#include <WebServer.h>
#include <WiFi.h>
// Generated from web/index.html by scripts/embed_web.py (gzip-compressed)
#include "generated/web_index_html.h"
// Generated by scripts/build_info.py
#include "generated/build_info.h"

namespace
{
    WebServer server(80);
    bool running = false;
    bool otaRejected = false;
    bool otaStarted = false;

    void sendJson(int code, const JsonDocument &doc)
    {
        String payload;
        serializeJson(doc, payload);
        server.send(code, "application/json", payload);
    }

    void sendError(int code, const char *message)
    {
        JsonDocument doc;
        doc["error"] = message;
        sendJson(code, doc);
    }

    bool authenticated()
    {
        return !settings.webPassword[0] || server.authenticate(WEB_USER, settings.webPassword);
    }

    // Optional login: asks the browser for credentials (Digest auth, password never sent in plain text)
    bool checkAuth()
    {
        if (authenticated())
            return true;
        server.requestAuthentication(DIGEST_AUTH, "Gaszaehler");
        return false;
    }

    // CSRF protection for state-changing requests: the dashboard sends a custom header,
    // which a foreign website cannot add without a CORS preflight (never granted here).
    // If the browser sends an Origin header, it must also match the Host.
    bool isTrustedRequest()
    {
        if (server.header("X-Requested-With") != "gaszaehler")
            return false;
        String origin = server.header("Origin");
        return origin.isEmpty() || origin == "http://" + server.hostHeader();
    }

    bool rejectUntrustedRequest()
    {
        if (!checkAuth())
            return true;
        if (isTrustedRequest())
            return false;
        Serial.println("Web: rejected request without valid X-Requested-With/Origin header");
        sendError(403, "forbidden");
        return true;
    }

    void handleRoot()
    {
        if (!checkAuth())
            return;
        server.sendHeader("Content-Encoding", "gzip");
        server.send_P(200, "text/html", reinterpret_cast<const char *>(WEB_INDEX_HTML_GZ), WEB_INDEX_HTML_GZ_LEN);
    }

    void handleStatus()
    {
        if (!checkAuth())
            return;
        uint32_t pulses, offset;
        meter::snapshot(pulses, offset);
        uint32_t total = pulses + offset;
        char formatted[16];
        formatVolume(formatted, sizeof(formatted), total);

        JsonDocument doc;
        doc["gasVolumeRaw"] = total;
        doc["gasVolumeM3"] = total / 100.0;
        doc["gasVolumeFormatted"] = formatted;
        doc["flowLitersPerHour"] = meter::flowLitersPerHour();
        doc["mqttConnected"] = mqtt::connected();
        doc["mqttServer"] = settings.mqttServer;
        doc["mqttPort"] = settings.mqttPort;
        doc["mqttUser"] = settings.mqttUser;
        doc["maskedPassword"] = settings.mqttPassword[0] ? "********" : "";
        doc["wifiConnected"] = WiFi.status() == WL_CONNECTED;
        doc["uptimeSeconds"] = millis() / 1000;
        doc["version"] = FIRMWARE_VERSION;
        doc["commit"] = BUILD_COMMIT;
        doc["commitDirty"] = BUILD_DIRTY;
        doc["projectUrl"] = PROJECT_URL;
        doc["clientID"] = settings.clientId;
        doc["mqttTopicGas"] = String(settings.clientId) + "/" + settings.topicGas;
        doc["mqttTopicCurrent"] = String(settings.clientId) + "/" + settings.topicCorrection;
        doc["mqttTopicBase"] = settings.topicGas;
        doc["mqttTopicCurrentBase"] = settings.topicCorrection;
        doc["offset"] = offset;
        doc["pulseCount"] = pulses;
        doc["mqttLastStatus"] = mqtt::status();
        doc["mqttLastAttemptUptime"] = mqtt::lastAttemptUptime();
        doc["mqttLastError"] = mqtt::lastError();
        sendJson(200, doc);
    }

    void handleConsumption()
    {
        if (rejectUntrustedRequest())
            return;
        if (!server.hasArg("value"))
            return sendError(400, "value missing");
        String arg = server.arg("value");
        uint32_t value;
        if (!parseMeterValue(arg.c_str(), arg.length(), value))
            return sendError(400, "invalid value (expected e.g. 12345.67, max 999999.99)");

        meter::setTotal(value);
        app::meterChanged();

        char formatted[16];
        formatVolume(formatted, sizeof(formatted), value);
        JsonDocument doc;
        doc["status"] = "ok";
        doc["value"] = value / 100.0;
        doc["gasVolumeFormatted"] = formatted;
        sendJson(200, doc);
    }

    void handleMqttConfig()
    {
        if (rejectUntrustedRequest())
            return;
        if (!server.hasArg("server") || !server.hasArg("port"))
            return sendError(400, "server and port required");
        String serverArg = server.arg("server");
        String portArg = server.arg("port");
        String userArg = server.arg("username");
        String passArg = server.arg("password");
        String clientIdArg = server.arg("clientid");
        String topicArg = server.arg("topic");
        String correctionArg = server.arg("topic_current");
        serverArg.trim();
        portArg.trim();
        clientIdArg.trim();
        topicArg.trim();
        correctionArg.trim();

        Settings s = settings;
        if (serverArg.isEmpty() || serverArg.length() >= sizeof(s.mqttServer))
            return sendError(400, "invalid server");
        if (parsePort(portArg.c_str()) == 0)
            return sendError(400, "port out of range");
        if (userArg.length() >= sizeof(s.mqttUser) || passArg.length() >= sizeof(s.mqttPassword))
            return sendError(400, "username or password too long");
        if (clientIdArg.length() && (clientIdArg.indexOf('/') >= 0 || !isValidTopic(clientIdArg.c_str(), sizeof(s.clientId))))
            return sendError(400, "invalid client ID");
        if ((topicArg.length() && !isValidTopic(topicArg.c_str(), sizeof(s.topicGas))) ||
            (correctionArg.length() && !isValidTopic(correctionArg.c_str(), sizeof(s.topicCorrection))))
            return sendError(400, "invalid topic (no + or #, no empty levels)");

        strlcpy(s.mqttServer, serverArg.c_str(), sizeof(s.mqttServer));
        strlcpy(s.mqttPort, portArg.c_str(), sizeof(s.mqttPort));
        strlcpy(s.mqttUser, userArg.c_str(), sizeof(s.mqttUser));
        // The dashboard never receives the stored password: an empty field means "keep it".
        // Without a username there is no authentication at all, so the password is cleared then.
        if (passArg.length() || userArg.isEmpty())
            strlcpy(s.mqttPassword, passArg.c_str(), sizeof(s.mqttPassword));
        if (clientIdArg.length())
            strlcpy(s.clientId, clientIdArg.c_str(), sizeof(s.clientId));
        if (topicArg.length())
            strlcpy(s.topicGas, topicArg.c_str(), sizeof(s.topicGas));
        if (correctionArg.length())
            strlcpy(s.topicCorrection, correctionArg.c_str(), sizeof(s.topicCorrection));

        char oldClientId[sizeof(Settings::clientId)];
        strlcpy(oldClientId, settings.clientId, sizeof(oldClientId));
        settings = s;
        app::settingsChanged(oldClientId);

        // The connection is established asynchronously; the dashboard polls /api/status
        JsonDocument doc;
        doc["status"] = "ok";
        doc["mqttConnected"] = mqtt::connected();
        doc["mqttServer"] = settings.mqttServer;
        doc["mqttPort"] = settings.mqttPort;
        doc["mqttLastStatus"] = "connecting";
        doc["clientID"] = settings.clientId;
        doc["mqttTopicBase"] = settings.topicGas;
        doc["mqttTopicCurrentBase"] = settings.topicCorrection;
        sendJson(200, doc);
    }

    void handleRestart()
    {
        if (rejectUntrustedRequest())
            return;
        JsonDocument doc;
        doc["status"] = "restarting";
        doc["message"] = "Device will restart now";
        sendJson(200, doc);
        app::saveAndRestart();
    }

    void handleFirmwareUpload()
    {
        HTTPUpload &upload = server.upload();
        if (upload.status == UPLOAD_FILE_START)
        {
            otaStarted = false;
            // Headers are parsed before the body, so these checks run before anything is flashed
            otaRejected = !isTrustedRequest() || !authenticated();
            if (otaRejected)
            {
                Serial.println("OTA: rejected untrusted upload");
                return;
            }
            Serial.printf("OTA: upload start %s\n", upload.filename.c_str());
            otaStarted = Update.begin(UPDATE_SIZE_UNKNOWN);
            if (!otaStarted)
                Update.printError(Serial);
        }
        else if (otaRejected || !otaStarted)
        {
            return;
        }
        else if (upload.status == UPLOAD_FILE_WRITE)
        {
            if (Update.write(upload.buf, upload.currentSize) != upload.currentSize)
                Update.printError(Serial);
        }
        else if (upload.status == UPLOAD_FILE_END)
        {
            if (Update.end(true))
                Serial.printf("OTA: update success (%u bytes)\n", upload.totalSize);
            else
                Update.printError(Serial);
        }
        else if (upload.status == UPLOAD_FILE_ABORTED)
        {
            Update.abort();
            otaStarted = false;
            Serial.println("OTA: upload aborted");
        }
    }

    void handleFirmwareUploadDone()
    {
        if (rejectUntrustedRequest())
            return;
        if (otaRejected)
            return sendError(403, "forbidden");
        bool success = otaStarted && Update.isFinished() && !Update.hasError();
        otaStarted = false;
        JsonDocument doc;
        doc["success"] = success;
        doc["message"] = success ? "Update successful" : "Update failed";
        sendJson(success ? 200 : 500, doc);
        if (success)
            app::saveAndRestart();
    }
}

namespace web
{
    void begin()
    {
        const char *headerKeys[] = {"X-Requested-With", "Origin"};
        server.collectHeaders(headerKeys, sizeof(headerKeys) / sizeof(headerKeys[0]));
        server.on("/", HTTP_GET, handleRoot);
        server.on("/api/status", HTTP_GET, handleStatus);
        server.on("/api/consumption", HTTP_POST, handleConsumption);
        server.on("/api/restart", HTTP_POST, handleRestart);
        server.on("/api/mqtt", HTTP_POST, handleMqttConfig);
        server.on("/update", HTTP_POST, handleFirmwareUploadDone, handleFirmwareUpload);
        server.onNotFound([]() { sendError(404, "not found"); });
    }

    void loop(bool portalActive, bool wifiConnected)
    {
        if (!running && !portalActive && wifiConnected)
        {
            server.begin();
            running = true;
            Serial.println("Web: dashboard on http://" + WiFi.localIP().toString());
        }
        else if (running && portalActive)
        {
            // Keep the dashboard on short Wi-Fi drops, stop it only for the portal
            server.stop();
            running = false;
            Serial.println("Web: dashboard stopped (config portal active)");
        }
        if (running)
            server.handleClient();
    }
}
